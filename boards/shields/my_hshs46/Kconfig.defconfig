## boards/shields/my_hshs46/Kconfig.defconfig
```kconfig
if SHIELD_MY_HSHS46_LEFT

config ZMK_KEYBOARD_NAME
    default "hshs46"

config ZMK_SPLIT_ROLE_CENTRAL
    default y

# Enable USB and ZMK Studio only on the left (central) half
config ZMK_USB
    default y

config USB_CDC_ACM
    default y

config ZMK_STUDIO
    default y

endif # SHIELD_MY_HSHS46_LEFT

if SHIELD_MY_HSHS46_LEFT || SHIELD_MY_HSHS46_RIGHT

config ZMK_SPLIT
    default y

endif # SHIELD_MY_HSHS46_LEFT || SHIELD_MY_HSHS46_RIGHT
```

## boards/shields/my_hshs46/Kconfig.shield
```kconfig
config SHIELD_MY_HSHS46_LEFT
    def_bool $(shields_list_contains,my_hshs46_left)

config SHIELD_MY_HSHS46_RIGHT
    def_bool $(shields_list_contains,my_hshs46_right)
```

## config/Kconfig.defconfig
```kconfig
if SHIELD_MY_HSHS46_LEFT

config ZMK_KEYBOARD_NAME
    default "hshs46"

config ZMK_SPLIT_ROLE_CENTRAL
    default y

endif # SHIELD_MY_HSHS46_LEFT

if SHIELD_MY_HSHS46_LEFT || SHIELD_MY_HSHS46_RIGHT

config ZMK_SPLIT
    default y

endif # SHIELD_MY_HSHS46_LEFT || SHIELD_MY_HSHS46_RIGHT
```
